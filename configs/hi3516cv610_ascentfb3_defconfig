## configs/hi3516cv610_ascentfb3_defconfig
```kconfig
CONFIG_ARM=y
# CONFIG_CMDLINE_EDITING is not set
CONFIG_SKIP_LOWLEVEL_INIT=y
CONFIG_ARM_SMCCC=y
CONFIG_SYS_THUMB_BUILD=y
# CONFIG_USE_ARCH_MEMCPY is not set
# CONFIG_USE_ARCH_MEMSET is not set
CONFIG_ARCH_BSP=y
CONFIG_SYS_TEXT_BASE=0x41800000
CONFIG_NR_DRAM_BANKS=1
CONFIG_ENV_SIZE=0x40000
CONFIG_ENV_OFFSET=0x80000
CONFIG_ENV_SECT_SIZE=0x20000
CONFIG_IDENT_STRING="hi3516cv610"
CONFIG_TARGET_HI3516CV610=y
CONFIG_VENDER_UBOOT_NAME="hi3516cv610"
CONFIG_SYS_LOAD_ADDR=0x42080000
CONFIG_FIT=y
CONFIG_BOOTSTAGE_STASH_SIZE=4096
# CONFIG_USE_BOOTARGS=y
CONFIG_BOOTARGS_SUBST=y
# CONFIG_DISPLAY_CPUINFO is not set
# CONFIG_DISPLAY_BOARDINFO is not set
CONFIG_HUSH_PARSER=y
CONFIG_SYS_PROMPT="OpenIPC # "
# CONFIG_CMD_ELF is not set
# CONFIG_CMD_FDT is not set
# CONFIG_CMD_IMI is not set
# CONFIG_CMD_XIMG is not set
# CONFIG_CMD_DDR_TRAINING is not set
# CONFIG_CMD_FLASH is not set
CONFIG_CMD_ECHO=y
CONFIG_CMD_ITEST=y
CONFIG_CMD_SOURCE=y
CONFIG_CMD_SETEXPR=y
CONFIG_CMD_DHCP=y
CONFIG_CMD_PING=y
CONFIG_CMD_CACHE=y
CONFIG_CMD_SMC=y
# CONFIG_CMD_IPCBOOT is not set
CONFIG_DOS_PARTITION=y
CONFIG_ENV_IS_IN_NAND=y
CONFIG_ENV_IS_IN_SPI_FLASH=y
CONFIG_ENV_SPI_BUS=0
CONFIG_ENV_SPI_CS=0
CONFIG_ENV_SPI_MAX_HZ=1000000
CONFIG_ENV_SPI_MODE=3
CONFIG_HAVE_BLOCK_DEVICE=y
CONFIG_NET=y
# CONFIG_MMC is not set
CONFIG_FS_FAT=y
CONFIG_MTD=y
CONFIG_FMC=y
CONFIG_MTD_RAW_NAND=y
CONFIG_FMC_SPI_NAND=y
CONFIG_FMC_SPI_NOR=y
CONFIG_SPI_BLOCK_PROTECT=y
CONFIG_PHY_USB=y
# CONFIG_POWER is not set
CONFIG_CONS_INDEX=0
CONFIG_PL011_SERIAL=y
CONFIG_USB=y
CONFIG_USB_GADGET=y
# CONFIG_GZIP is not set
CONFIG_HWDEC_V1=y
CONFIG_OF_LIBFDT=y
CONFIG_BOOTDELAY=1
CONFIG_BSP_DISABLE_DOWNLOAD=y
CONFIG_CMD_NET=y
# CONFIG_CMD_BOOTP is not set
# CONFIG_CMD_PCAP is not set
CONFIG_CMD_TFTPBOOT=y
CONFIG_CMD_TFTPPUT=y
# CONFIG_CMD_TFTPSRV is not set
CONFIG_NET_TFTP_VARS=y
# CONFIG_CMD_RARP is not set
# CONFIG_CMD_NFS is not set
CONFIG_NET_RANDOM_ETHADDR=y
CONFIG_ENV_IS_IN_SPI_FLASH=y
# CONFIG_DELAY_ENVIRONMENT is not set
CONFIG_ENV_IS_IN_NAND=y
# CONFIG_BOOTM_NETBSD is not set
# CONFIG_BOOTM_OPENRTOS is not set
# CONFIG_BOOTM_OSE is not set
# CONFIG_BOOTM_PLAN9 is not set
# CONFIG_BOOTM_RTEMS is not set
# CONFIG_BOOTM_VXWORKS is not set
CONFIG_CMD_LOADB=y
CONFIG_VERSION_VARIABLE=y
CONFIG_CMD_MTDPARTS=y
CONFIG_USB_GADGET_VENDOR_NUM=0x0451
CONFIG_USB_GADGET_PRODUCT_NUM=0xd022
CONFIG_USB_DWC3=y
CONFIG_USB_DWC3_GADGET=y
CONFIG_MTDIDS_DEFAULT="nand0=nand0"
CONFIG_MTDPARTS_DEFAULT="mtdparts=nand0:512k(boot),512k(env),1m(sel),4m(kernel0),4m(kernel1),6m(factory),16m(rootfs0),16m(rootfs1),32m(usrdata0),32m(usrdata1)"
CONFIG_USB_FUNCTION_FASTBOOT=y
CONFIG_CMD_FASTBOOT=y
CONFIG_FASTBOOT_FLASH=y
CONFIG_FASTBOOT_FLASH_NAND=y
CONFIG_FASTBOOT_FLASH_NAND_TRIMFFS=y
CONFIG_FASTBOOT_BUF_ADDR=0x42000000
CONFIG_FASTBOOT_BUF_SIZE=0x4000000
CONFIG_USB_ETHER=y
CONFIG_USB_ETH_RNDIS=y
```
